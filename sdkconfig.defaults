## sdkconfig.defaults
```kconfig
# Flash configuration for 4MB ESP32
CONFIG_ESPTOOLPY_FLASHSIZE_4MB=y
CONFIG_ESPTOOLPY_FLASHSIZE="4MB"

# Partition table configuration
CONFIG_PARTITION_TABLE_CUSTOM=y
CONFIG_PARTITION_TABLE_CUSTOM_FILENAME="partitions_4mb.csv"

# Increase main task stack size to prevent overflow
CONFIG_ESP_MAIN_TASK_STACK_SIZE=12288

# Enable MQTT over SSL
CONFIG_ESP_TLS_USING_MBEDTLS=y

# WiFi configuration
CONFIG_ESP_WIFI_AUTH_WPA2_PSK=y

# SNTP configuration
CONFIG_LWIP_SNTP_MAX_SERVERS=3

# HTTP server configuration to prevent crashes
CONFIG_HTTPD_MAX_REQ_HDR_LEN=2048
CONFIG_HTTPD_MAX_URI_LEN=1024
CONFIG_HTTPD_QUEUE_WORK_BLOCKING=y

# Memory configuration
CONFIG_ESP_HTTP_CLIENT_ENABLE_HTTPS=y

# OTA Configuration - Enable app rollback for safe updates
CONFIG_BOOTLOADER_APP_ROLLBACK_ENABLE=y
CONFIG_BOOTLOADER_APP_ANTI_ROLLBACK=n
CONFIG_APP_ROLLBACK_ENABLE=y

# HTTPS OTA Settings
CONFIG_ESP_HTTPS_OTA_ALLOW_HTTP=n
CONFIG_ESP_HTTPS_OTA_RECV_TIMEOUT=30000

# Allow insecure TLS connections for GitHub CDN OTA (firmware still validated after download)
CONFIG_ESP_TLS_INSECURE=y
CONFIG_ESP_TLS_SKIP_SERVER_CERT_VERIFY=y

# LWIP/TCP settings optimized for PPP connections
CONFIG_LWIP_TCP_MSS=1460
CONFIG_LWIP_TCP_SND_BUF_DEFAULT=5744
CONFIG_LWIP_TCP_WND_DEFAULT=5744
CONFIG_LWIP_TCP_RECVMBOX_SIZE=12
CONFIG_LWIP_TCP_SYNMAXRTX=6
CONFIG_LWIP_TCP_MAXRTX=12
CONFIG_LWIP_TCPIP_RECVMBOX_SIZE=32

# PPP settings
CONFIG_LWIP_PPP_SUPPORT=y
CONFIG_LWIP_PPP_PAP_SUPPORT=y
CONFIG_LWIP_PPP_CHAP_SUPPORT=y
CONFIG_LWIP_PPP_MSCHAP_SUPPORT=y
CONFIG_LWIP_ENABLE_PPP_DEBUG=n
CONFIG_LWIP_PPP_VJ_HEADER_COMPRESSION=n

# mbedTLS settings for better compatibility with mobile networks
CONFIG_MBEDTLS_SSL_IN_CONTENT_LEN=8192
CONFIG_MBEDTLS_SSL_OUT_CONTENT_LEN=4096
CONFIG_MBEDTLS_ASYMMETRIC_CONTENT_LEN=y
CONFIG_MBEDTLS_SSL_VARIABLE_BUFFER_LENGTH=y
CONFIG_MBEDTLS_SSL_RENEGOTIATION=n
CONFIG_MBEDTLS_SSL_KEEP_PEER_CERTIFICATE=n

# HTTP Client settings
CONFIG_ESP_HTTP_CLIENT_ENABLE_BASIC_AUTH=n
CONFIG_ESP_HTTP_CLIENT_ENABLE_DIGEST_AUTH=n

# FAT Filesystem settings - protect SD card from corruption on power loss
CONFIG_FATFS_IMMEDIATE_FSYNC=y
```
